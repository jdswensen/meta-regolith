## conf/distro/regolith.conf
```bitbake
require conf/distro/poky.conf

DISTRO = "regolith"
DISTRO_NAME = "regolith"
SDK_VENDOR = "-regolith"
TARGET_VENDOR = "-regolith"

DISTRO_FEATURES ?= "${DISTRO_FEATURES_DEFAULT} ${DISTRO_FEATURES_LIBC}"
PACKAGE_CLASSES ?= "package_ipk"
```

## conf/layer.conf
```bitbake
# We have a conf and classes directory, add to BBPATH
BBPATH .= ":${LAYERDIR}"

# We have a packages directory, add to BBFILES
BBFILES += "${LAYERDIR}/recipes-*/*/*.bb \
            ${LAYERDIR}/recipes-*/*/*.bbappend"

BBFILE_COLLECTIONS += "regolith"
BBFILE_PATTERN_regolith = "^${LAYERDIR}/"
BBFILE_PRIORITY_regolith = "10"
```

## conf/machine/qemuarma9.conf
```bitbake
#@TYPE: Machine
#@NAME: arm_versatile_cortexa9
#@DESCRIPTION: arm_versatile_cortexa9

require conf/machine/include/qemu.inc
require conf/machine/include/tune-cortexa9.inc

KERNEL_IMAGETYPE = "zImage"
KERNEL_DEVICETREE = "vexpress-v2p-ca9.dtb"

# align image size to sd card block size
IMAGE_ROOTFS_ALIGNMENT = "512"

SERIAL_CONSOLE = "115200 ttyAMA0"

# For runqemu
QB_SYSTEM_NAME = "qemu-system-arm"
QB_MACHINE = "-machine vexpress-a9"
QB_KERNEL_CMDLINE_APPEND = "console=ttyAMA0,115200 console=tty"
QB_OPT_APPEND = "-show-cursor "
PREFERRED_VERSION_linux-yocto ??= "4.12%"
QB_DTB = "vexpress-v2p-ca9.dtb"
QB_KERNEL_ROOT = "/dev/mmcblk0"
QB_ROOTFS_OPT = "-drive if=sd,driver=raw,cache=writeback,file=@ROOTFS@"
QB_NETWORK_DEVICE = "-net nic,macaddr=@MAC@"
QB_TAP_OPT = "-net tap,vlan=0,ifname=@TAP@,script=no,downscript=no"
```
